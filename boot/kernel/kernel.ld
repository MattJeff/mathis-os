/* ============================================================================
 * MATHIS OS Kernel Linker Script
 * ============================================================================
 * This script defines the memory layout for the kernel.
 * All sections grow dynamically - no fixed addresses.
 *
 * MEMORY MAP:
 *   0x10000 - ...     : Code + Data (grows dynamically)
 *   0x90000           : Max kernel size (512KB)
 * ============================================================================ */

OUTPUT_FORMAT(elf64-x86-64)
OUTPUT_ARCH(i386:x86-64)
ENTRY(kernel_entry)

KERNEL_BASE = 0x10000;
KERNEL_SIZE = 0x80000;  /* 512KB */

SECTIONS
{
    /* ════════════════════════════════════════════════════════════════════════
     * ENTRY SECTION (0x10000)
     * First code to execute - kernel entry point (32-bit)
     * ════════════════════════════════════════════════════════════════════════ */
    . = KERNEL_BASE;

    .entry : {
        *(.entry)
    }

    /* ════════════════════════════════════════════════════════════════════════
     * TEXT SECTION - All executable code
     * ════════════════════════════════════════════════════════════════════════ */
    .text : {
        *(.text)
        *(.text.*)
    }

    /* ════════════════════════════════════════════════════════════════════════
     * RODATA SECTION - Read-only data (strings, tables)
     * ════════════════════════════════════════════════════════════════════════ */
    .rodata : {
        *(.rodata)
        *(.rodata.*)
    }

    /* ════════════════════════════════════════════════════════════════════════
     * DATA SECTION - Initialized variables
     * ════════════════════════════════════════════════════════════════════════ */
    .data : {
        *(.data)
        *(.data.*)
    }

    /* ════════════════════════════════════════════════════════════════════════
     * BSS SECTION - Uninitialized variables
     * ════════════════════════════════════════════════════════════════════════ */
    .bss : {
        *(.bss)
        *(.bss.*)
    }

    /* ════════════════════════════════════════════════════════════════════════
     * PADDING - Ensure kernel fits in 512KB max
     * ════════════════════════════════════════════════════════════════════════ */
    . = KERNEL_BASE + KERNEL_SIZE;
}
